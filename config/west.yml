## config/west.yml
```yaml
manifest:
  defaults:
    revision: main
  remotes:
    - name: zmkfirmware
      url-base: https://github.com/zmkfirmware
  projects:
    - name: zmk
      remote: zmkfirmware
      import: app/west.yml
    - name: lotus58_ble_firmware
      url: https://github.com/tCreepyShadow/lotus58_ble_firmware
      revision: main
      path: modules/lotus58_ble_firmware
    - name: zmk-tri-state
      url: https://github.com/urob/zmk-tri-state
      revision: main
  self:
    path: config
```
